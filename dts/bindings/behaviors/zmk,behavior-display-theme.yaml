## dts/bindings/behaviors/zmk,behavior-display-theme.yaml
```yaml
description: Control the display theme (light/dark) of the stock status screen

compatible: "zmk,behavior-display-theme"

include: one_param.yaml
```

## dts/bindings/behaviors/zmk,behavior-nvgem.yaml
```yaml
description: Control the nice_view_gem display theme (light/dark)

compatible: "zmk,behavior-nvgem"

include: one_param.yaml
```
